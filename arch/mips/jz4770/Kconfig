## arch/mips/jz4770/Kconfig
```kconfig
choice
	prompt "JZ4770 board selection"
	depends on SOC_JZ4770
	default JZ4770_ALTAIR

config JZ4770_TVB
        bool "Ingenic JZ4770 TVB board"
	select DMA_NONCOHERENT
	select SYS_HAS_CPU_MIPS32_R1
	select SYS_SUPPORTS_32BIT_KERNEL
	select SYS_SUPPORTS_LITTLE_ENDIAN
	select SYS_HAS_EARLY_PRINTK

config JZ4770_N55
        bool "Ingenic JZ4770 N55 board"
	select DMA_NONCOHERENT
	select SYS_HAS_CPU_MIPS32_R1
	select SYS_SUPPORTS_32BIT_KERNEL
	select SYS_SUPPORTS_LITTLE_ENDIAN
	select SYS_HAS_EARLY_PRINTK
	
config JZ4770_LINDEN
        bool "Ingenic JZ4770 Linden board"
	select DMA_NONCOHERENT
	select SYS_HAS_CPU_MIPS32_R1
	select SYS_SUPPORTS_32BIT_KERNEL
	select SYS_SUPPORTS_LITTLE_ENDIAN
	select SYS_HAS_EARLY_PRINTK

config LINDEN_V_1_0
        bool "Ingenic JZ4770 LINDEN v1.0 board"
	depends on JZ4770_LINDEN

config LINDEN_V_1_1
        bool "Ingenic JZ4770 LINDEN v1.1 board"
	depends on JZ4770_LINDEN

config JZ4770_LINDEN111
        bool "Ingenic JZ4770 Linden v1.1.1 board"
	select DMA_NONCOHERENT
	select SYS_HAS_CPU_MIPS32_R1
	select SYS_SUPPORTS_32BIT_KERNEL
	select SYS_SUPPORTS_LITTLE_ENDIAN
	select SYS_HAS_EARLY_PRINTK

config JZ4770_NPM701
        bool "Ingenic JZ4770 NPM701 board"
	select DMA_NONCOHERENT
	select SYS_HAS_CPU_MIPS32_R1
	select SYS_SUPPORTS_32BIT_KERNEL
	select SYS_SUPPORTS_LITTLE_ENDIAN
	select SYS_HAS_EARLY_PRINTK

config NPM701_V_1_0
        bool "Ingenic JZ4770 NPM701 v1.0 board"
	depends on JZ4770_NPM701

config NPM701_V_1_1
        bool "Ingenic JZ4770 NPM701 v1.1 board"
	depends on JZ4770_NPM701
config JZ4770_NPM702
        bool "Ingenic JZ4770 NPM702 board"
	select DMA_NONCOHERENT
	select SYS_HAS_CPU_MIPS32_R1
	select SYS_SUPPORTS_32BIT_KERNEL
	select SYS_SUPPORTS_LITTLE_ENDIAN
	select SYS_HAS_EARLY_PRINTK

config JZ4770_NPM703
        bool "Ingenic JZ4770 NPM703 board"
	select DMA_NONCOHERENT
	select SYS_HAS_CPU_MIPS32_R1
	select SYS_SUPPORTS_32BIT_KERNEL
	select SYS_SUPPORTS_LITTLE_ENDIAN
	select SYS_HAS_EARLY_PRINTK

config JZ4770_O1
        bool "Ingenic JZ4770 o1 board"
	select DMA_NONCOHERENT
	select SYS_HAS_CPU_MIPS32_R1
	select SYS_SUPPORTS_32BIT_KERNEL
	select SYS_SUPPORTS_LITTLE_ENDIAN
	select SYS_HAS_EARLY_PRINTK

config JZ4770_COBY7022
        bool "Ingenic JZ4770 coby7022 board"
	select DMA_NONCOHERENT
	select SYS_HAS_CPU_MIPS32_R1
	select SYS_SUPPORTS_32BIT_KERNEL
	select SYS_SUPPORTS_LITTLE_ENDIAN
	select SYS_HAS_EARLY_PRINTK

config JZ4770_AURORA
        bool "Ingenic JZ4770 AURORA board"
	select DMA_NONCOHERENT
	select SYS_HAS_CPU_MIPS32_R1
	select SYS_SUPPORTS_32BIT_KERNEL
	select SYS_SUPPORTS_LITTLE_ENDIAN
	select SYS_HAS_EARLY_PRINTK

config JZ4770_PS47
        bool "Ingenic JZ4770 PS47 board"
	select DMA_NONCOHERENT
	select SYS_HAS_CPU_MIPS32_R1
	select SYS_SUPPORTS_32BIT_KERNEL
	select SYS_SUPPORTS_LITTLE_ENDIAN
	select SYS_HAS_EARLY_PRINTK

config JZ4770_PI3800
        bool "Ingenic JZ4770 pi3800 board"
        select DMA_NONCOHERENT
        select SYS_HAS_CPU_MIPS32_R1
        select SYS_SUPPORTS_32BIT_KERNEL
        select SYS_SUPPORTS_LITTLE_ENDIAN
        select SYS_HAS_EARLY_PRINTK

config JZ4770_TABLET_7_HD_C 
        bool "Ingenic JZ4770 Tablet_7_HD_C board"
        select DMA_NONCOHERENT
        select SYS_HAS_CPU_MIPS32_R1
        select SYS_SUPPORTS_32BIT_KERNEL
        select SYS_SUPPORTS_LITTLE_ENDIAN
        select SYS_HAS_EARLY_PRINTK

config JZ4770_JB01
        bool "Ingenic JZ4770 JB01 board"
	select DMA_NONCOHERENT
	select SYS_HAS_CPU_MIPS32_R1
	select SYS_SUPPORTS_32BIT_KERNEL
	select SYS_SUPPORTS_LITTLE_ENDIAN
	select SYS_HAS_EARLY_PRINTK
	
config JZ4770_PISCES
        bool "Ingenic JZ4770 PISCES board"
	select DMA_NONCOHERENT
	select SYS_HAS_CPU_MIPS32_R1
	select SYS_SUPPORTS_32BIT_KERNEL
	select SYS_SUPPORTS_LITTLE_ENDIAN
	select SYS_HAS_EARLY_PRINTK


endchoice

config NAND_DEVICE_ID
       depends on SOC_JZ4770
       bool "Support read device ID from NAND Flash"

config ANDROID_CTS
       depends on SOC_JZ4770
       bool "Support FOR ANDROID PRODUCT CTS"
```

## drivers/i2c/chips/Kconfig
```kconfig
#
# Miscellaneous I2C chip drivers configuration
#
# *** DEPRECATED! Do not add new entries! See Makefile ***
#

menu "Miscellaneous I2C Chip support"

config SENSORS_NEW
	tristate "use the new sensors hardware.the driver should provide  manys interface for the andriod"
	depends on EXPERIMENTAL
	help
		this is make the driver used for the andriod sensors.
config SENSORS_JZ_MMA8452
        tristate "JZ g_sensor MMA8452 driver"
        depends on I2C
        help

config SENSORS_JZ_MMA8452_AS_INPUT
	bool "JZ g_sensor MMA8452 as a input device"
	depends on SENSORS_JZ_MMA8452
	help

config SENSORS_JZ_MMA8452_ORI
	bool "JZ g_sensor MMA8452 orientation sensor "
	depends on SENSORS_JZ_MMA8452
	help

config SENSORS_MMA7455L
	tristate "Freescale MMA7455L 3-axis low-g accelerometer"
	depends on I2C
	help
	  Say yes if wanna get support for Freescale 2g/4g/8g
	  3-axis low-g accelerometer

	  This driver cans also be built as a module. In that case,
	  the module name would be mma7455l.

config MMA7455L_AS_INPUT
	bool "MMA7455L as a input device"
	depends on SENSORS_MMA7455L
	help

config SENSORS_MMA8452_ORI
	bool "MMA8452 orientation sensor "
	depends on SENSORS_MMA8452
	help

config SENSORS_LIS33DE_35DE
	tristate "LIS33DE and LIS35DE 3-axis low-g accelerometer"
	depends on I2C
	help
	  Say yes if wanna get support for mems 2g/8g

	  This driver cans also be built as a module. In that case,
	  the module name would be lis35de.

config LIS33DE_35DE_AS_INPUT
	bool "LIS33DE and LIS35DE as a input device"
	depends on SENSORS_LIS33DE_35DE

config SENSORS_LIS33DE_35DE_ORI
	bool "Lis33de and Lis35de fake orientation sensor"
	depends on SENSORS_LIS33DE_35DE

config SENSORS_LSM303DLH_ACC
	tristate "LSM303DLH_ACC 3-axis accelerometer"
	depends on I2C
	help
	  Say yes if wanna get support for mems 2g/4g/8g

	  This driver cans also be built as a module. In that case,
	  the module name would be lis303dlh.

config LSM303DLH_ACC_AS_INPUT
	bool "LSM303DLH as a input device"
	depends on SENSORS_LSM303DLH_ACC
	help

config SENSORS_LSM303DLH_ORI
	bool "Lsm303dlh fake orientation sensor"
	depends on SENSORS_LSM303DLH_ACC
	help 

config SENSORS_LSM303DLH_MAG
	tristate "LSM303DLH_MAG 3-aixs magnetometer"
	depends on I2C
	help
	  Say yes if wanna get support for mems 2g/4g/8g

	  This driver cans also be built as a module. In that case,
	  the module name would be lis303dlh.

config LSM303DLH_MAG_AS_INPUT
	bool "LSM303DLH as a input device"
	depends on SENSORS_LSM303DLH_MAG
	help 

endmenu
```

## drivers/video/hdmi/Kconfig
```kconfig
config FB_JZ47XX_HDMI_CAPTION
    bool "JZ47XX_HDMI_CAPTION support"
	depends on JZ47XX_HDMI
    ---help---
    If your device has a hdmi interface you can select it.It is used for
    support hdmi caption. 

choice
    depends on JZ47XX_HDMI
    prompt  "HDMI Chip Select"

config HDMI_IT6610
	bool "HDMI IT6610"
config HDMI_HOTPLUG_MODE
	depends on HDMI_IT6610
	bool "HDMI hotplug mode"
	default y
config HDMI_HOTPLUG_HPD_CONNECT_LOW_ACTIVE
	depends on HDMI_HOTPLUG_MODE
	bool "HDMI connection is low active"
	default y
#source "drivers/video/hdmi/it6610/Kconfig"
config HDMI_EP932
	bool "HDMI EP932"
config HDMI_NULL
	bool "NULL"

endchoice
```

## drivers/video/panel/Kconfig
```kconfig
#
# LCD Panel Configuration
#
comment "JZ47XX Android LCD TFT Panel Select"
	depends on FB_JZ47XX_ANDROID_TFT

config ANDROID_LCD_HDMI_DEFAULT
	depends on FB_JZ47XX_ANDROID_TFT
	bool "Default HDMI output (24bits)"

config HDMI_DEFAULT_WIDTH
	int "Default HDMI output width"
	depends on ANDROID_LCD_HDMI_DEFAULT
	default "1280"
	help
	  The default value of HDMI output width.

config HDMI_DEFAULT_HEIGHT
	int "Default HDMI output height"
	depends on ANDROID_LCD_HDMI_DEFAULT
	default "720"
	help
	  The default value of HDMI output height.

config HDMI_DEFAULT_FPS
	int "Default HDMI output FPS"
	depends on ANDROID_LCD_HDMI_DEFAULT
	default "60"
	help
	  The default value of HDMI output FPS.

config ANDROID_LCD_AUO_A043FL01V2
	depends on FB_JZ47XX_ANDROID_TFT
	bool "AUO A043FL01V2 TFT panel (480x272)(24bits)"

config ANDROID_LCD_FOXCONN_PT035TN01
	depends on FB_JZ47XX_ANDROID_TFT
	bool "FOXCONN PT035TN01 parellel TFT panel (320x240, 3.5in)(24bits)"

config ANDROID_LCD_INNOLUX_PT035TN01_SERIAL
	depends on FB_JZ47XX_ANDROID_TFT
	bool "INNOLUX PT035TN01 8bit-serial TFT panel (320x240, 3.5in)(24bits)"

config ANDROID_LCD_TOPPOLY_TD043MGEB1
	depends on FB_JZ47XX_ANDROID_TFT
	bool "TOPPOLY_TD043MGEB1 TFT panel(800x480)(24bit mode)"

config ANDROID_LCD_SAMSUNG_AMS369FG06
	depends on FB_JZ47XX_ANDROID_TFT
	bool "SAMSUNG_AMS369FG06 TFT panel(480x800)(24bit mode)"

config ANDROID_LCD_SAMSUNG_LMS350DF04
	depends on FB_JZ47XX_ANDROID_TFT
	bool "SAMSUNG_LMS350DF04 TFT panel(320x480)(24bit mode)"

config ANDROID_LCD_TRULY_TFT_ER61581
	depends on FB_JZ47XX_ANDROID_TFT
	bool "Turly ER61581 TFT panel(320X480) 16 bit"

config ANDROID_LCD_TRULY_TFT_RM68040
	depends on FB_JZ47XX_ANDROID_TFT
	bool "Turly RM68040 TFT panel(320X480) 16 bit"

config ANDROID_LCD_HIMAX_TFT_HX8357
	depends on FB_JZ47XX_ANDROID_TFT
	bool "Himax HX8357 TFT panel(320X480) 16 bit"

config ANDROID_LCD_YUE_TFT_YL10922NT
	depends on FB_JZ47XX_ANDROID_TFT
	bool "shian yue yl10922 TFT panel(320X480) 16 bit"

config ANDROID_LCD_KD50G9_40NM_B1
	depends on FB_JZ47XX_ANDROID_TFT
	bool "KD50G9_40NM_B1 TFT panel(800x480)(24bit mode)"

config ANDROID_LCD_KD50G2_40NM_A2
	depends on FB_JZ47XX_ANDROID_TFT
	bool "KD50G2_40NM_A2 TFT panel(800x480)(24bit mode)"

config ANDROID_LCD_LS032T8HX01
	depends on FB_JZ47XX_ANDROID_TFT
	bool "LS032T8HX01 TFT panel(800x480)(24bit mode)"
	
config ANDROID_LCD_AT070TN93
	depends on FB_JZ47XX_ANDROID_TFT
	bool "AT070TN93 TFT panel(800x480)(24bit mode)"
	
config ANDROID_LCD_AT070TNA2
	depends on FB_JZ47XX_ANDROID_TFT
	bool "AT070TNA2 TFT LVDS panel(1024x600)(24bit mode)"

config ANDROID_LCD_HANNSTAR_HSD070IDW1_A
	depends on FB_JZ47XX_ANDROID_TFT
	bool "HANNSTAR HSD070IDW1-A TFT panel(800x480)(24bit mode)"

config ANDROID_LCD_HYNIX_HT12X14
	depends on FB_JZ47XX_ANDROID_TFT
	bool "HYNIX_HT12X14 TFT panel(1024x768)(24bit mode)"

config ANDROID_LCD_INNOLUX_AT070TN90
	depends on FB_JZ47XX_ANDROID_TFT
	bool "INNOLUX_AT070TN90 TFT panel(800x480)(24bit mode)"

config ANDROID_LCD_CPT_CLAA070MA21BW
	depends on FB_JZ47XX_ANDROID_TFT
	bool "CPT (Chunghwa Picture Tubes) CLAA070MA21BW  TFT panel(800x600)(24bit mode)"

config ANDROID_LCD_BYD_BM1024600
	depends on FB_JZ47XX_ANDROID_TFT
	bool "BYD BYD BM1024600  TFT panel(1024x600)(24bit mode)"

config ANDROID_LCD_TL080WX800
	depends on FB_JZ47XX_ANDROID_TFT
	bool "TUWUXIAN TL080WX800 LVDS panel(1280x768)(24bit mode)"

config ANDROID_LCD_AUO_A043FL01V2
	depends on FB_JZ47XX_ANDROID_TFT
	bool "AUO A043FL01V2 TFT panel(480x272)(24bit mode)"

config ANDROID_LCD_LTN097XL01_A01
	depends on FB_JZ47XX_ANDROID_TFT
	bool "SAMSUNG LTN097XL01_A01 LVDS TFT panel(1024x768)()"

config ANDROID_LCD_KD080D3_40NB_A3
	depends on FB_JZ47XX_ANDROID_TFT
	bool "King Display KD080D3_40NB_A3 LVDS TFT panel(1024x768)()"

config ANDROID_LCD_HV070WSA_100
	depends on FB_JZ47XX_ANDROID_TFT
	bool "HV070WSA_100 LVDS TFT panel(1024x600)()"

config ANDROID_LCD_M156B3_LA1
	depends on FB_JZ47XX_ANDROID_TFT
	bool "M156B3_LA1 LVDS TFT panel(1366x768)()"

config ANDROID_LCD_HLY070ML290
	depends on FB_JZ47XX_ANDROID_TFT
	bool "HLY070ML290 TFT panel(800x480)()"
config ANDROID_LCD_TM080SFH01
	depends on FB_JZ47XX_ANDROID_TFT
	bool "TM080SFH01 TFT panel(800x600)()"
```
